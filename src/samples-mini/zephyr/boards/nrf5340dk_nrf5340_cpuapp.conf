## src/samples-mini/zephyr/boards/nrf5340dk_nrf5340_cpuapp.conf
```kconfig
CONFIG_ARM_MPU=y
CONFIG_MAIN_STACK_SIZE=4096
CONFIG_SYSTEM_WORKQUEUE_STACK_SIZE=4096
CONFIG_COMMON_LIBC_MALLOC_ARENA_SIZE=-1
CONFIG_HEAP_MEM_POOL_SIZE=32768

# Container defaults - Reduced for nRF5340's limited RAM
CONFIG_MAX_CONTAINERS=2
CONFIG_OCRE_WAMR_HEAP_BUFFER_SIZE=180000
CONFIG_OCRE_CONTAINER_DEFAULT_HEAP_SIZE=4096
CONFIG_OCRE_CONTAINER_DEFAULT_STACK_SIZE=4096

# DISABLE OCRE SHELL (this is what's causing the shell_fprintf errors!)
CONFIG_OCRE_SHELL=n

# Disable the main Zephyr shell AND all shell subsystems
CONFIG_NET_SHELL=n
CONFIG_FILE_SYSTEM_SHELL=n
CONFIG_SENSOR_SHELL=n

# Override shell-related configs from prj.conf since shell is disabled

# Random number generator (REQUIRED by networking and RNG sensor)
CONFIG_ENTROPY_GENERATOR=y
CONFIG_TEST_RANDOM_GENERATOR=y

# Reduce networking stack sizes to save RAM
CONFIG_NET_TX_STACK_SIZE=1024
CONFIG_NET_RX_STACK_SIZE=2048
CONFIG_NET_BUF_TX_COUNT=8
CONFIG_NET_BUF_RX_COUNT=16
CONFIG_NET_MGMT_EVENT_STACK_SIZE=1024
CONFIG_NET_PKT_RX_COUNT=8
CONFIG_NET_PKT_TX_COUNT=8
CONFIG_NET_BUF_DATA_SIZE=128

# Bus interfaces
CONFIG_GPIO=y

# Ocre Sensors support
CONFIG_SENSOR=y
CONFIG_OCRE_SENSORS=y
CONFIG_RNG_SENSOR=y

# Ocre GPIO Support (minimal)
CONFIG_OCRE_GPIO=y
CONFIG_OCRE_GPIO_MAX_PORTS=4
CONFIG_OCRE_GPIO_PINS_PER_PORT=8
CONFIG_OCRE_GPIO_MAX_PINS=32

# Disable container messaging to save RAM
CONFIG_OCRE_CONTAINER_MESSAGING=y

# Enable container filesystem for WASI stdio
CONFIG_OCRE_CONTAINER_FILESYSTEM=y

# CONFIG_BOOTLOADER_MCUBOOT=n
# # CONFIG_IMG_MANAGER=n
# CONFIG_MCUBOOT_IMG_MANAGER=n
# CONFIG_STREAM_FLASH=n
# CONFIG_IMG_ERASE_PROGRESSIVELY=n

# Flash settings
CONFIG_FLASH=y
CONFIG_FLASH_MAP=y
CONFIG_FLASH_PAGE_LAYOUT=y

# Serial/UART
CONFIG_SERIAL=y
CONFIG_UART_CONSOLE=y
CONFIG_CONSOLE=y

# Reduce other buffers
CONFIG_ZVFS_OPEN_MAX=8
CONFIG_ZVFS_EVENTFD_MAX=5

CONFIG_LOG_TRACE_SHORT_TIMESTAMP=n

CONFIG_SHELL_PROMPT_UART=""
```

## src/samples/demo/zephyr/boards/b_u585i_iot02a.conf
```kconfig
# @copyright Copyright (c) contributors to Project Ocre,
# which has been established as Project Ocre a Series of LF Projects, LLC
#
# SPDX-License-Identifier: Apache-2.0

CONFIG_STM32_MEMMAP=y
CONFIG_OCRE_MERGE_HEX=y
```

## src/samples/demo/zephyr/boards/pico_plus2_rp2350b_m33_w.conf
```kconfig
# @copyright Copyright (c) contributors to Project Ocre,
# which has been established as Project Ocre a Series of LF Projects, LLC
#
# SPDX-License-Identifier: Apache-2.0

CONFIG_TEST_RANDOM_GENERATOR=y
CONFIG_SHARED_MULTI_HEAP=y
```

## src/samples/supervisor/zephyr/boards/b_u585i_iot02a.conf
```kconfig
# @copyright Copyright (c) contributors to Project Ocre,
# which has been established as Project Ocre a Series of LF Projects, LLC
#
# SPDX-License-Identifier: Apache-2.0

CONFIG_STM32_MEMMAP=y
CONFIG_OCRE_MERGE_HEX=y

# PSRAM
CONFIG_MEMC=y
CONFIG_MEMC_STM32_OSPI_PSRAM=y
CONFIG_SHARED_MULTI_HEAP=y
```

## src/samples/supervisor/zephyr/boards/native_sim_64.conf
```kconfig
# @copyright Copyright (c) contributors to Project Ocre,
# which has been established as Project Ocre a Series of LF Projects, LLC
#
# SPDX-License-Identifier: Apache-2.0

CONFIG_COMMON_LIBC_MALLOC_ARENA_SIZE=10485760
CONFIG_UART_NATIVE_PTY_0_ON_STDINOUT=y
CONFIG_UART_NATIVE_PTY=y
```

## src/samples/supervisor/zephyr/boards/pico_plus2_rp2350b_m33.conf
```kconfig
CONFIG_TEST_RANDOM_GENERATOR=y
CONFIG_SHARED_MULTI_HEAP=y
CONFIG_WIFI=y
CONFIG_NET_L2_WIFI_SHELL=y
```

## src/samples/supervisor/zephyr/boards/pico_plus2_rp2350b_m33_w.conf
```kconfig
CONFIG_TEST_RANDOM_GENERATOR=y
CONFIG_SHARED_MULTI_HEAP=y

# for led
CONFIG_NETWORKING=y
CONFIG_WIFI=y
```

## src/samples/supervisor/zephyr/boards/pico_plus2_rp2350b_m33_w_mcuboot.conf
```kconfig
CONFIG_TEST_RANDOM_GENERATOR=y

# for led
CONFIG_NETWORKING=y
CONFIG_WIFI=y
CONFIG_MAIN_STACK_SIZE=2048
```

## src/samples/supervisor/zephyr/boards/shields/enc28j60/Kconfig.defconfig
```kconfig
# @copyright Copyright (c) contributors to Project Ocre,
# which has been established as Project Ocre a Series of LF Projects, LLC
#
# SPDX-License-Identifier: Apache-2.0

if SHIELD_ENC28J60

config NET_L2_ETHERNET
	default y

config ETH_ENC28J60
	default y

config ETH_ENC28J60_RX_THREAD_STACK_SIZE
	default 2048
    
endif # SHIELD_ENC28J60
```

## src/samples/supervisor/zephyr/boards/shields/enc28j60/Kconfig.shield
```kconfig
# @copyright Copyright (c) contributors to Project Ocre,
# which has been established as Project Ocre a Series of LF Projects, LLC
#
# SPDX-License-Identifier: Apache-2.0

config SHIELD_ENC28J60
	def_bool $(shields_list_contains,enc28j60)
    
```

## src/samples/supervisor/zephyr/boards/shields/wiznet_w5500/Kconfig.defconfig
```kconfig
# @copyright Copyright (c) contributors to Project Ocre,
# which has been established as Project Ocre a Series of LF Projects, LLC
#
# SPDX-License-Identifier: Apache-2.0

if SHIELD_WIZNET_W5500

config ETH_W5500_RX_THREAD_STACK_SIZE
	default 1024

endif # SHIELD_WIZNET_W5500
```

## src/samples/supervisor/zephyr/boards/shields/wiznet_w5500/Kconfig.shield
```kconfig
# @copyright Copyright (c) contributors to Project Ocre,
# which has been established as Project Ocre a Series of LF Projects, LLC
#
# SPDX-License-Identifier: Apache-2.0

config SHIELD_WIZNET_W5500
	def_bool $(shields_list_contains,wiznet_w5500)
```

## tests/system/zephyr/context/boards/native_sim_64.conf
```kconfig
# @copyright Copyright (c) contributors to Project Ocre,
# which has been established as Project Ocre a Series of LF Projects, LLC
#
# SPDX-License-Identifier: Apache-2.0

CONFIG_COMMON_LIBC_MALLOC_ARENA_SIZE=10485760
```
