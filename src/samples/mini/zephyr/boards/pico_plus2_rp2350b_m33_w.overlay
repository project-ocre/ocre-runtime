&flash0 {
	partitions {
		compatible = "fixed-partitions";
		#address-cells = <1>;
		#size-cells = <1>;

	  	storage_partition: partition@600000 {
	  		label = "storage";
	        reg = <0x410000 0x800000>;
	  	};
	};
};
