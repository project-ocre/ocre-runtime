/**
 * @copyright Copyright (c) contributors to Project Ocre,
 * which has been established as Project Ocre a Series of LF Projects, LLC
 *
 * SPDX-License-Identifier: Apache-2.0
 */
 
&storage_partition{
    reg = <0x000f0000 DT_SIZE_K(512)>;
};
