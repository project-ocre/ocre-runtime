&spi1 {
    eth0: ethernet@0 {
        status = "okay";
        compatible = "microchip,enc28j60";
        reg = <0>;
        spi-max-frequency = <10000000>;
        int-gpios = <&gpioc 1 GPIO_ACTIVE_LOW>;
        local-mac-address = [ 00 80 00 01 02 03 ];
    };
};
