## zephyr/Kconfig
```kconfig
# @copyright Copyright (c) contributors to Project Ocre,
# which has been established as Project Ocre a Series of LF Projects, LLC
#
# SPDX-License-Identifier: Apache-2.0

config OCRE
	bool "Ocre Runtime"
	default n
    select THREAD_STACK_INFO
    select DYNAMIC_THREAD
    select DYNAMIC_THREAD_ALLOC
    select POSIX_API
    select FLASH
    select FLASH_MAP
    select FILE_SYSTEM
    select FILE_SYSTEM_LITTLEFS
    select NETWORKING
  help
	  Enable the Project Ocre runtime.

if OCRE

config OCRE_DEFAULT_WORKING_DIRECTORY
    string "Default OCRE working directory"
    default "/lfs/ocre"
    help
        Default working directory for OCRE.

# Default minimum system heap required by OCRE
config HEAP_MEM_POOL_ADD_SIZE_OCRE
	def_int 32768 # 32KB

comment "Storage partition"

config OCRE_STORAGE_PARTITION
    bool "Enable building of storage partition binary"
    default $(dt_nodelabel_exists,storage_partition)

if OCRE_STORAGE_PARTITION

    config OCRE_STORAGE_PARTITION_ADDR
    hex "User data partition address"
    default "$(add_hex,$(dt_node_reg_addr_hex,$(dt_node_parent,$(dt_node_parent,$(dt_nodelabel_path,storage_partition)))),$(dt_nodelabel_reg_addr_hex,storage_partition))"
    help
        littlefs user data partition address.

config OCRE_STORAGE_PARTITION_SIZE
  int "User data partition size"
  default $(dt_nodelabel_reg_size_int,storage_partition)
  help
    littlefs user data partition size in bytes.

config OCRE_STORAGE_PARTITION_BLOCK_SIZE
  hex "User data partition block size"
  default "0x1000" if !$(dt_node_has_prop,$(dt_node_parent,$(dt_node_parent,$(dt_nodelabel_path,storage_partition))),erase-block-size)
  default "$(dt_node_int_prop_hex,$(dt_node_parent,$(dt_node_parent,$(dt_nodelabel_path,storage_partition))),erase-block-size)"
  help
    littlefs user data partition size in bytes.

config OCRE_MERGE_HEX
    bool "Merge user_data partition in merged.hex"
    default n
    help
        Enable to include littlefs formatted user_data partition
        to be merged into merged.hex.

endif

comment "WAMR options"

config OCRE_WAMR_INTERPRETER
    bool "Enable WASM interpreter"
    default y
    help
        Enable interpreting WASM code.

config OCRE_WAMR_AOT
    bool "Enable AOT execution"
    default n
    help
        Enable execution of ahead of time compiled code.

comment "Container features"

config OCRE_NETWORKING
    bool "Enable container networking support"
    default n
    select NET_IPV4
    select NET_IPV6
    select NET_UDP
    select NET_TCP
    select NET_SOCKETS
    help
        Enable networking support for containers.

config OCRE_FILESYSTEM
    bool "Enable Container file system support"
    default n
    help
      Enable support for containers to access the filesystem

config OCRE_TIMER
    bool "Enable OCRE Timer Driver"
    select OCRE_CONTAINER_MESSAGING
    default n
    help
        Enable the OCRE Timer driver that provides a portable API layer
        for Timer operations across different hardware platforms.

if OCRE_TIMER
config OCRE_MAX_TIMERS
    int "Maximum number of timers"
    default 8
    help
      Defines the maximum number of timers available in the system.
endif # OCRE_TIMER

config OCRE_CONTAINER_MESSAGING
    bool "Enable OCRE Container Messaging support"
    default n
    help
      Enable support for OCRE Container Messaging

if OCRE_CONTAINER_MESSAGING

config OCRE_MESSAGING_MAX_SUBSCRIPTIONS
    int "Number of maximum subscriptions for Container Messaging"
    default 16
    help
      Number of maximum subscriptions for Container Messaging

endif # OCRE_CONTAINER_MESSAGING

config OCRE_SHARED_HEAP
    bool "Enable container shared heap support"
    default n
    help
        Enable shared heap support for containers.

if OCRE_SHARED_HEAP

choice OCRE_SHARED_HEAP_MODE
    prompt "Shared heap mode"
    default OCRE_SHARED_HEAP_BUF_VIRTUAL
    help
      Select the shared heap memory mode:
      - Physical: Map physical hardware registers (e.g., GPIO) to WASM address space
      - Virtual: Allocate shared heap from regular RAM

config OCRE_SHARED_HEAP_BUF_PHYSICAL
    bool "Physical (hardware register mapping)"
    help
      Enable physical memory mapping for hardware access.
      Maps physical hardware registers (like GPIO at 0x42020000) to WASM address space.
      Use this when containers need direct access to hardware peripherals.

config OCRE_SHARED_HEAP_BUF_VIRTUAL
    bool "Virtual (RAM allocation)"
    help
      Enable virtual shared heap allocated from regular RAM.
      Use this for normal inter-module communication without
      direct hardware access.

endchoice

if OCRE_SHARED_HEAP_BUF_PHYSICAL

config OCRE_SHARED_HEAP_BUF_ADDRESS
    hex "Shared heap buffer address"
    default 0x00
    help
      Shared heap buffer address. Memory address of hardware registers.

endif # OCRE_SHARED_HEAP_BUF_PHYSICAL

config OCRE_SHARED_HEAP_BUF_SIZE
    int "Shared heap buffer size in bytes"
    default 65536
    help
      Size of the pre-allocated buffer for the shared heap.
      This memory is shared between WebAssembly modules.

endif # OCRE_SHARED_HEAP

comment "Control Interface"

config OCRE_SHELL
    bool "Enable OCRE Shell"
    select SHELL
    select SHELL_GETOPT
    select HTTP_CLIENT
    select DNS_RESOLVER
    default n
    help
        Enable the OCRE Shell for dynamic configuration management.

config OCRE_HTTP_SERVER
    bool "Enable OCRE native HTTP request/response API"
    depends on HTTP_SERVER
    default n
    help
        Runs a native HTTP server (Zephyr's http_server subsystem, outside
        the WASM sandbox) that catches every request regardless of path or
        method and hands it to the active container's exported
        "onRequest(requestId)" function. The container reads the request
        with ocre_http_get_method/path/query/header/body and answers with
        ocre_http_respond -- all routing logic lives in container code, not
        in the native layer.

if OCRE_HTTP_SERVER

config OCRE_HTTP_SERVER_PORT
    int "Port for the OCRE native HTTP server"
    default 8081
    help
        TCP port the native HTTP server listens on.

endif # OCRE_HTTP_SERVER

config OCRE_HTTP_CLIENT
    bool "Enable OCRE native outbound HTTP client API"
    depends on HTTP_CLIENT
    default n
    help
        Exposes a blocking ocre_http_get() to WASM containers, letting
        container code issue outbound HTTP GET requests via Zephyr's HTTP
        client subsystem (outside the WASM sandbox) and read the response
        body back into container memory. Runs on the calling instance's own
        thread, so -- like any blocking native call -- it stalls that
        instance's loop()/onRequest() dispatch for the duration of the
        request.

if OCRE_HTTP_CLIENT

config OCRE_HTTP_CLIENT_TIMEOUT_MS
    int "Timeout for OCRE HTTP client requests"
    default 5000
    help
        Timeout, in milliseconds, for outbound requests made via
        ocre_http_get().

endif # OCRE_HTTP_CLIENT

config OCRE_LOOP_INTERVAL_MS
    int "Interval, in milliseconds, between native calls to a container's loop()"
    default 100
    help
        Once a container's "main" export returns, if it also exports a
        "loop" function, the native side keeps calling it on this interval
        (in place of the container looping forever inside a single WASM
        call) until the container is replaced or removed.

comment "Logging"

module = OCRE
module-str = OCRE
source "subsys/logging/Kconfig.template.log_config"

config OCRE_WAMR_LOG_LEVEL
    int "Log level for WAMR"
    default 2
    range 0 4
    help
        Set the log level for the WAMR runtime:
        0: Fatal
        1: Error
        2: Warning
        3: Debug
        4: Verbose

comment "Container hardware drivers"

config OCRE_GPIO
    bool "Enable OCRE GPIO Driver"
    default n
    help
      Enable the OCRE GPIO driver that provides a portable API layer
      for GPIO operations across different hardware platforms.

if OCRE_GPIO
config OCRE_GPIO_MAX_PINS
    int "Maximum number of GPIO pins"
    default 32
    help
      Maximum number of GPIO pins that can be managed by the OCRE GPIO driver.

config OCRE_GPIO_MAX_PORTS
    int "Maximum number of GPIO ports"
    default 4
    help
      Maximum number of GPIO port devices that can be used by the OCRE GPIO driver.

config OCRE_GPIO_PINS_PER_PORT
    int "Number of pins per GPIO port"
    default 32
    help
      Number of pins available on each GPIO port. This is used to map the
      logical pin numbers to physical port and pin numbers.

endif # OCRE_GPIO

config OCRE_ADC
    bool "Enable OCRE ADC (analog input) support"
    depends on ADC
    default n
    help
      Exposes named analog-input channels (e.g. "a0") to WASM containers,
      pre-scaled to 0-255. Resolves channels via the same devicetree
      "zephyr,user" io-channels convention as Zephyr's own
      samples/drivers/adc/adc_dt sample, so the native code is unchanged
      across boards -- only a board's devicetree overlay determines which
      channel names actually resolve.

if OCRE_ADC
config OCRE_ADC_MAX_CHANNELS
    int "Maximum number of named ADC channels"
    default 4
    help
      Maximum number of named analog-input channels ("a0".."a3") the OCRE
      ADC driver will resolve at init time.

config OCRE_ADC_VREF_MV
    int "Full-scale voltage (mV) used to scale ADC readings to 0-255"
    default 3300
    help
      Assumed full-scale input voltage, in millivolts, for channels whose
      reference voltage is known from devicetree (e.g. zephyr,vref-mv).
      Channels without a known reference voltage instead scale the raw
      ADC code directly against the channel's resolution.

endif # OCRE_ADC

config OCRE_SENSORS
    bool "Enable OCRE Sensors support"
    default n
    depends on SENSOR
    help
      Enable support for OCRE sensors

if OCRE_SENSORS
config OCRE_MAX_SENSORS
    int "Maximum number of sensors"
    default 10
    help
    Defines the maximum number of sensors that can be handled.

config OCRE_MAX_CHANNELS_PER_SENSOR
    int "Maximum number of channels per sensor"
    default 5
    help
    Defines the maximum number of channels that each sensor can have.

config OCRE_RNG_SENSOR
    bool "RNG Sensor"
    default n
    help
      Enable support for the custom RNG sensor.

config OCRE_IMU_SENSOR
    bool "IMU Sensor"
    default n
    help
      Enable support for the custom IMU sensor.

endif # OCRE_SENSORS

endif # OCRE
```
